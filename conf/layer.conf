## conf/layer.conf
```bitbake
# Copyright (C) 2023 LDV
# Released under the MIT license (see COPYING.MIT for the terms)

# We have a conf and classes directory, add to BBPATH
BBPATH .= ":${LAYERDIR}"

# We have recipes-* directories, add to BBFILES
BBFILES += "${LAYERDIR}/recipes-*/*/*.bb ${LAYERDIR}/recipes-*/*/*.bbappend"

BBFILE_COLLECTIONS += "rk35"
BBFILE_PATTERN_rk35 = "^${LAYERDIR}/"
BBFILE_PRIORITY_rk35 = "1"

# This should only be incremented on significant changes that will
# cause compatibility issues with other layers
LAYERVERSION_rk35 = "1"
#LAYERSERIES_COMPAT_rk35 = "nanbield scarthgap"
LAYERSERIES_COMPAT_rk35 = "scarthgap"
LAYERDEPENDS_rk35 = "core"
#LAYERDEPENDS_rk = "core meta-arm"
```

## conf/machine/include/rk3566.inc
```bitbake
MACHINEOVERRIDES =. "rk3566:"
DEFAULTTUNE ?= "cortexa55"

require conf/machine/include/arm/armv8-2a/tune-cortexa55.inc
require conf/machine/include/rockchip-defaults.inc
require conf/machine/include/rockchip-wic.inc

KERNEL_FEATURES:append:rk3566 = " bsp/rockchip/remove-non-rockchip-arch-arm64.scc"

PREFERRED_PROVIDER_trusted-firmware-a = "rockchip-rkbin"
PREFERRED_PROVIDER_optee-os = "rockchip-rkbin"

# Add initramfs if needed
INITRAMFS_IMAGE ?= "${@ 'rk35-initramfs' if d.getVar('RK35_INITRAMFS') == "1" else '' }"
INITRAMFS_FSTYPES ?= "${@ 'cpio.gz.u-boot' if d.getVar('RK35_INITRAMFS') == "1" else ''}" 
# vim:set ft=bitbake:
```

## conf/machine/include/rockchip-defaults.inc
```bitbake
# meta-rk35 default settings

# kernel Provider and version
PREFERRED_PROVIDER_virtual/kernel ?= "linux-yocto"
PREFERRED_VERSION_virtual/kernel ?="6.6%"

# Use default Kernel configuration values if not defined
KCONFIG_MODE ?= "alldefconfig"

# Use defaults for kernel configuration
KBUILD_DEFCONFIG ?= "defconfig"

# Default kenerl image "Image"
KERNEL_IMAGETYPE ?= "Image"
#KERNEL_CLASSES ??= "kernel-fitimage"

# UBOOT defaults
UBOOT_SUFFIX ?= "itb"
UBOOT_ENTRYPOINT ?= "0x06000000"

# xserver
XSERVER = " \
	xserver-xorg \
	xserver-xorg-utils \
	xserver-xorg-xvfb \
	xserver-xorg-extension-glx \
	xserver-xorg-module-libwfb \
	xserver-xorg-module-exa \
	xf86-video-modesetting \
	xf86-input-evdev \
	xf86-input-mouse \
	"

# misc
SERIAL_CONSOLES ?= "1500000;ttyS2"
```

## conf/machine/include/rockchip-wic.inc
```bitbake
# common meta-rk35 wic/wks items

SPL_BINARY ?= "u-boot-rockchip.bin"

IMAGE_FSTYPES += "wic.gz wic.bmap"
WKS_FILE = "rockchip-simple.wks"
WKS_FILE_DEPENDS ?= " \
	mtools-native \
	dosfstools-native \
	e2fsprogs-native \
	virtual/bootloader \
	virtual/kernel \
	"
IMAGE_BOOT_FILES = " \
	${KERNEL_IMAGETYPE} \
	${@bb.utils.contains('KERNEL_IMAGETYPE', 'fitImage', '', '${KERNEL_DEVICETREE}', d)} \
	${@bb.utils.contains('KERNEL_IMAGETYPE', 'fitImage', '', 'boot.scr', d)} \
	${@ d.getVar('RK35_BOOT_ENV') + '.txt' if (d.getVar('RK35_BOOT_ENV') or '').strip() else ''} \
	${@ 'devicetree/*.dtbo;dtbo/' if (d.getVar('RK35_BOOT_ENV') or '').strip() else ''} \
	${@bb.utils.contains('RK35_INSTALL_EXTRA','1','u-boot/*;u-boot/','',d)} \
	"


# arm64 dbts are under <vendor>/dts but is deployed under DEPLOYDIR 
do_fix_device_tree_location() {

    for kdt in ${KERNEL_DEVICETREE}
    do
        local dbt_dir=$(dirname ${kdt})
        if [ "." != "${dbt_dir}" ] ; then
            local dbt=$(basename ${kdt})
            local dst=${DEPLOY_DIR_IMAGE}/${dbt_dir}/${dbt}
            if [ ! -f ${dst} ] ; then
                mkdir -p ${DEPLOY_DIR_IMAGE}/$dbt_dir
                ln -s ${DEPLOY_DIR_IMAGE}/${dbt} ${dst}
            fi
        fi
    done
}


addtask do_fix_device_tree_location after do_write_wks_template before do_image_wic


# use the first-defined <baud>;<device> pair in SERIAL_CONSOLES
# for the console parameter in the wks files
RK_CONSOLE_BAUD ?= "${@d.getVar('SERIAL_CONSOLES').split(';')[0]}"
RK_CONSOLE_DEVICE ?= "${@d.getVar('SERIAL_CONSOLES').split(';')[1].split()[0]}"

WICVARS:append = " \
	RK_CONSOLE_BAUD \
	RK_CONSOLE_DEVICE \
	SPL_BINARY \
	UBOOT_SUFFIX \
	"
# vim: ft=bitbake
```

## conf/machine/include/rv1106.inc
```bitbake
MACHINEOVERRIDES =. "rv1106:"
#DEFAULTTUNE ?= "cortexa7hf-neon-vfpv4"

require conf/machine/include/arm/armv7a/tune-cortexa7.inc

# Use specific u-boot provided by pico sdk
PREFERRED_PROVIDER_u-boot="u-boot-pico"
PREFERRED_PROVIDER_virtual/bootloader="u-boot-pico"
# Use specific kernel provided by pico sdk
#PREFERRED_PROVIDER_linux="linux-pico"
PREFERRED_PROVIDER_virtual/kernel="linux-pico"

#UBOOT - set .img the extension of the u-boot binary
UBOOT_SUFFIX = "img"

# WKS - Custom wks with mrb partion
IMAGE_FSTYPES += "wic.gz wic.bmap"
WKS_FILE = "rockchip-rv11xx.wks"
WKS_FILE_DEPENDS ?= " \
	mtools-native \
	dosfstools-native \
	e2fsprogs-native \
	virtual/bootloader \
	virtual/kernel \
	"

# Defaults to zImage
KERNEL_IMAGETYPE ?= "zImage"

# Files in the boot partition kernel + dt.dtb
IMAGE_BOOT_FILES += " \
	${KERNEL_IMAGETYPE}  \
        ${KERNEL_DEVICETREE};dt.dtb \
"


# Set serial consoles
SERIAL_CONSOLES ?= "115200;ttyFIQ0"

#Disable tty1 as the chip does not have video
SYSVINIT_ENABLED_GETTYS := ""
```

## conf/machine/orangepi-3b.conf
```bitbake
#@TYPE: Machine
#@NAME: Orange Pi 3B
#@DESCRIPTION: Orange Pi 3B raspberry Pi 3 alternative based on RK3566 with great storage capabilities.
#http://www.orangepi.org/html/hardWare/computerAndMicrocontrollers/details/Orange-Pi-3B.html

require conf/machine/include/rk3566.inc

KERNEL_FEATURES:append = " bsp/rk35/common-tweaks.scc bsp/rk35/pcie.scc bsp/rk35/uwe5622/uwe5622.scc"
KERNEL_DEVICETREE = "rockchip/rk3566-orangepi-3b.dtb"
MACHINE_EXTRA_RRECOMMENDS += "kernel-modules uwe5622-firmware"
UBOOT_MACHINE = "orangepi-3b-rk3566_defconfig"

# Add kernel modules to enable wifi & BT
KERNEL_MODULE_AUTOLOAD:append = " sprdwl_ng sprdbt_tty"
```

## conf/machine/pico-mini.conf
```bitbake
#@TYPE: Machine
#@NAME: Luckfox pico mini A or b
#@DESCRIPTION: eSBC based on RV1103
# https://wiki.luckfox.com/Luckfox-Pico/Luckfox-Pico-quick-start

require conf/machine/include/rv1106.inc

UBOOT_MACHINE = "rv1106_defconfig"
KERNEL_DEVICETREE = "rv1103g-luckfox-pico-mini-a.dtb"

MACHINE_EXTRA_RRECOMMENDS += "kernel-modules"
MACHINE_FEATURES:append = " serial usbgadget usbhost"
MACHINE_FEATURES:remove = " rtc"

# Add g_ether to auto load
KERNEL_MODULE_AUTOLOAD += "g_ether"
```

## wic/rockchip-rv11xx.wks
```
# Disk layout form pico-sdk
# Modified with relocation environment.
# Or
# PICO SDK => RK_PARTITION_CMD_IN_ENV="32K(env),512K@32K(idblock),256K(uboot),32M(boot),512M(oem),256M(userdata),6G(rootfs),-(media)"
# Rellocated
# blkdevparts=mmcblk1:8@24K(env),512K@32K(idblock),-(uboot)
#
#   Partition   Start K      Size K
#   env     	24K             8K      --Not in partition table --
#   idblock     32K		512K    --Not in partition table --
#   uboot	544K		1024K   --Not in partition table --
#   /boot	1588K


part env 	--offset 24 	--fixed-size 8K 	--source rawcopy --sourceparams="file=u-boot-default-env.img" --no-table
part idblock	--offset 32 	--fixed-size 512K	--source rawcopy --sourceparams="file=idblock.img" --no-table
part uboot	--offset 544	--fixed-size 1024K	--source rawcopy --sourceparams="file=u-boot.img"  --no-table
part /boot	--offset 1588   --size       114688K --active --source bootimg-partition --fstype=vfat --label boot --use-uuid
part /                                                        --source rootfs            --fstype=ext4 --label root --use-uuid

bootloader --ptable msdos
```
